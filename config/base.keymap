#include <behaviors.dtsi>
#include <behaviors/num_word.dtsi> // Requires auto-layer module.
#include <dt-bindings/zmk/keys.h>
#ifdef CONFIG_WIRELESS
  #include <dt-bindings/zmk/bt.h>
  #include <dt-bindings/zmk/outputs.h>
  #define _BT_SEL_KEYS_                                                        \
      &bt BT_CLR &bt BT_SEL 0 &bt BT_SEL 1 &bt BT_SEL 2 &bt BT_SEL 3 &bt BT_SEL 4
  #define _BT_SEL_KEYS_2_                                                      \
      &bt BT_CLR &bt BT_SEL 5 &bt BT_SEL 6 &bt BT_SEL 7 &bt BT_SEL 8 &bt BT_SEL 9
#else
  #define _BT_SEL_KEYS_   &trans &trans &trans &trans &trans &trans
  #define _BT_SEL_KEYS_2_ &trans &trans &trans &trans &trans &trans
#endif

#include "zmk-helpers/helper.h"
#include "zmk-helpers/unicode-chars/greek.dtsi"
#include "zmk-helpers/unicode-chars/german.dtsi"

#define DFL  0
#define GML  1
#define GAL  2
#define DTL  3
#define EPL  4
#define ZEL  5
#define SDL  6
#define SUL  7
#define LWL  8
#define REL  9
#define RSL 10
#define AJL 11
#define SSL 12
#define HSL 13
#define KSL 14
#define CSL 15
#define SLL 16
#define FSL 17
#define BHL 18
#define WHL 19
#define WPL 20

#define DEF 21
#define NAV 22
#define FN  23
#define NUM 24
#define SYS 25
#define UC  26
#define MOUSE 27

#define XXX &none
#define ___ &trans

/* Global defaults */

#define QUICK_TAP_MS 175

&sk {
  release-after-ms = <900>;
  quick-release;
};

&sl { // Allow sticky mods to chord across sticky layers.
  ignore-modifiers;
};

&lt {
  flavor = "balanced";
  tapping-term-ms = <200>;
  quick-tap-ms = <QUICK_TAP_MS>;
};

/* Homerow mods */

#define KEYS_L LT0 LT1 LT2 LT3 LT4 LM0 LM1 LM2 LM3 LM4 LB0 LB1 LB2 LB3 LB4
#define KEYS_R RT0 RT1 RT2 RT3 RT4 RM0 RM1 RM2 RM3 RM4 RB0 RB1 RB2 RB3 RB4
#ifndef LH2
  #define THUMBS LH1 LH0 RH0 RH1         // Thumbs on 34 keys.
#else
  #define THUMBS LH2 LH1 LH0 RH0 RH1 RH2 // Thumbs on 36+ keys.
#endif

#define MAKE_HRM(NAME, HOLD, TAP, TRIGGER_POS)                                 \
  ZMK_HOLD_TAP(NAME, bindings = <HOLD>, <TAP>; flavor = "balanced";            \
               tapping-term-ms = <280>; quick-tap-ms = <QUICK_TAP_MS>;         \
               require-prior-idle-ms = <150>; hold-trigger-on-release;         \
               hold-trigger-key-positions = <TRIGGER_POS>;)

MAKE_HRM(hml, &kp, &kp, KEYS_R THUMBS) // Left-hand HRMs.
MAKE_HRM(hmr, &kp, &kp, KEYS_L THUMBS) // Right-hand HRMs.

// Hack: Make HRM combos tap-only (cf, ZMK issue #544).
#define ZMK_COMBO_8(NAME, TAP, POS, LAYERS, COMBO_MS, IDLE_MS, HOLD, SIDE)     \
  MAKE_HRM(hm_combo_##NAME, &kp, TAP, SIDE THUMBS)                             \
  ZMK_COMBO_6(NAME, &hm_combo_##NAME HOLD 0, POS, LAYERS, COMBO_MS, IDLE_MS)

/* Combos, leader key sequences, mouse emulation */

#include "combos.dtsi" // Must be sourced after HRM-combo hack.
#include "leader.dtsi"
#include "mouse.dtsi"

/* Nav cluster */

// Trigger tap-action on all interrupts
#define MT_CORE                                                                \
  flavor = "tap-preferred";                                                    \
  tapping-term-ms = <220>;                                                     \
  quick-tap-ms = <220>;                                                        \
  hold-trigger-key-positions = <0>;

&mt { MT_CORE };

ZMK_HOLD_TAP(mt_home, bindings = <&masked_home>, <&kp>; MT_CORE)
ZMK_HOLD_TAP(mt_end, bindings = <&masked_end>, <&kp>; MT_CORE)

#define NAV_LEFT  &mt_home 0   LEFT  // Tap: left  | Long-tap: start of line.
#define NAV_RIGHT &mt_end 0    RIGHT // Tap: right | Long-tap: end   of line.
#define NAV_UP    &mt LC(HOME) UP    // Tap: up    | Long-tap: start of doc.
#define NAV_DOWN  &mt LC(END)  DOWN  // Tap: down  | Long-tap: end   of doc.
#define NAV_BSPC  &mt LC(BSPC) BSPC  // Tap: bspc  | Long-tap: delete word bwd.
#define NAV_DEL   &mt LC(DEL)  DEL   // Tap: del   | Long-tap: delete word fwd.

// Mask CTRL on left/right hold to avoid accidental jumps to start/end of doc.
#define MASK_MODS(NAME, MODS, BINDING)                                         \
  ZMK_MOD_MORPH(NAME, bindings = <BINDING>, <BINDING>; mods = <MODS>;)

MASK_MODS(masked_home, (MOD_LCTL), &kp HOME)
MASK_MODS(masked_end,  (MOD_LCTL), &kp END)

/* Magic-shift & auto-layers */

// Tap: repeat after alpha, else sticky-shift |
// Shift + tap/ double-tap: caps-word | Hold: shift.
#define MAGIC_SHIFT &magic_shift LSHFT 0
ZMK_HOLD_TAP(magic_shift, bindings = <&kp>, <&magic_shift_tap>;
             flavor = "balanced"; tapping-term-ms = <200>;
             quick-tap-ms = <QUICK_TAP_MS>;)
ZMK_MOD_MORPH(magic_shift_tap, bindings = <&shift_repeat>, <&caps_word>;
              mods = <(MOD_LSFT)>;)
ZMK_ADAPTIVE_KEY(
    shift_repeat, bindings = <&sk LSHFT>;
    repeat {
      trigger-keys = <A B C D E F G H I J K L M N O P Q R S T U V W X Y Z>;
      bindings = <&key_repeat>;
      max-prior-idle-ms = <1200>;
      strict-modifiers;
    };)
&caps_word { // Mods deactivate caps-word, requires PR #1451. [TODO: rebase]
  /delete-property/ ignore-modifiers;
};

// Tap: num-word | double-tap: sticky num-layer | Hold: num-layer.
#define SMART_NUM &smart_num NUM 0
ZMK_HOLD_TAP(smart_num, bindings = <&mo>, <&num_dance>; flavor = "balanced";
             tapping-term-ms = <200>; quick-tap-ms = <QUICK_TAP_MS>;)
ZMK_TAP_DANCE(num_dance, bindings = <&num_word NUM>, <&sl NUM>;
              tapping-term-ms = <200>;)

// Smart-mouse, requires tri-state module.
ZMK_TRI_STATE(
    smart_mouse, bindings = <&tog MOUSE>, <&none>, <&tog MOUSE>;
    ignored-key-positions =
        <LT1 LT2 LH0 LH1 RT1 RT2 RT3 RM0 RM1 RM2 RM3 RM4 RB1 RB2 RB3 RH0 RH1>;
    ignored-layers = <MOUSE NAV FN>;)

/* Custom behaviors */

// Alt+Tab swapper, requires tri-state module.
ZMK_TRI_STATE(swapper, bindings = <&kt LALT>, <&kp TAB>, <&kt LALT>;
              ignored-key-positions = <LT2 RT2 RM1 RM2 RM3>;)

// Define mod-morph with a *single* mod trigger for less repetition.
#define SIMPLE_MORPH(NAME, MOD, BINDING1, BINDING2)                            \
  ZMK_MOD_MORPH(NAME, mods = <(MOD_L##MOD | MOD_R##MOD)>;                      \
                bindings = <BINDING1>, <BINDING2>;)

// Tap: comma | Shift + tap: semicolon | Ctrl + shift + tap: <.
SIMPLE_MORPH(comma_morph, SFT, &kp COMMA, &comma_inner_morph)
SIMPLE_MORPH(comma_inner_morph, CTL, &kp SEMICOLON, &kp LESS_THAN)

// Tap: dot | Shift + tap: colon | Ctrl + shift + tap: >.
SIMPLE_MORPH(dot_morph, SFT, &kp DOT, &dot_inner_morph)
SIMPLE_MORPH(dot_inner_morph, CTL, &kp COLON, &kp GREATER_THAN)

// Tap: qmark | Shift + tap: excl.
SIMPLE_MORPH(qexcl, SFT, &kp QMARK, &kp EXCL)

// Tap: left/right parenthesis | Shft + tap: less-than/greater-than.
SIMPLE_MORPH(lpar_lt, SFT, &kp LPAR, &kp LT)
SIMPLE_MORPH(rpar_gt, SFT, &kp RPAR, &kp GT)

// Tap: space | Shift + tap: dot -> space -> sticky shift | Hold: nav layer.
ZMK_HOLD_TAP(lt_spc, bindings = <&mo>, <&spc_morph>; flavor = "balanced";
             tapping-term-ms = <200>; quick-tap-ms = <QUICK_TAP_MS>;)
SIMPLE_MORPH(spc_morph, SFT, &kp SPACE, &dot_spc)
ZMK_MACRO(dot_spc, bindings = <&kp DOT &kp SPACE &sk LSHFT>; wait-ms = <0>;
          tap-ms = <5>;)

// Tap: backspace | Lshft + tap: delete | Rshft + tap: shift-delete.
ZMK_MOD_MORPH(bs_del, bindings = <&kp BSPC>, <&kp DEL>;
              mods = <(MOD_LSFT|MOD_RSFT)>; keep-mods = <MOD_RSFT>;)

// Tap: copy | double-tap: cut.
ZMK_TAP_DANCE(copy_cut, bindings = <&kp LC(INS)>, <&kp LC(X)>;
              tapping-term-ms = <200>;)

// Sticky shift + leader.
ZMK_MACRO(leader_sft, bindings = <&sk LSHFT &leader>;)

// Misc aliases. [TODO: clean up]
#define CANCEL    &kp K_CANCEL            // Cancel caps-word & auto-layers.
#define DSK_PREV  &hmr LCTRL LG(LC(LEFT)) // Previous desktop.
#define DSK_NEXT  &hmr LALT LG(LC(RIGHT)) // Next     desktop.
#define PIN_WIN   &kp LG(LC(LS(Q)))       // Pin window across desktops.
#define PIN_APP   &kp LG(LC(LS(A)))       // Pin application across desktops.
#define DSK_MGR   &kp LA(GRAVE)           // Desktop manager.
#define VOL_DOWN  &hmr RSHFT C_VOL_DN

/* Keymap */

ZMK_CONDITIONAL_LAYER(realspace_layer, SDL SUL, RSL)
ZMK_CONDITIONAL_LAYER(adjust_layer, LWL REL, AJL)
ZMK_CONDITIONAL_LAYER(subspace_layer, SDL LWL, SSL)
ZMK_CONDITIONAL_LAYER(hyperspace_layer, SUL REL, HSL)
ZMK_CONDITIONAL_LAYER(knownspace_layer, SDL REL, KSL)
ZMK_CONDITIONAL_LAYER(cyberspace_layer, LWL SUL, CSL)
ZMK_CONDITIONAL_LAYER(slipspace_layer, SSL REL, SLL)
ZMK_CONDITIONAL_LAYER(foldspace_layer, LWL HSL, FSL)
ZMK_CONDITIONAL_LAYER(blackhole_layer, SSL SUL, BHL)
ZMK_CONDITIONAL_LAYER(whitehole_layer, SDL HSL, WHL)
ZMK_CONDITIONAL_LAYER(warp_layer, SSL HSL, WPL)
ZMK_CONDITIONAL_LAYER(sys_layer, FN NUM, SYS)


ZMK_LAYER(default, // 0
//╭──────╮ ┌───────────────┬───────┬───────┬──────────┬───────────────┬──────────────┐ ╭──────╮ ┌─────────────┬───────────────┬───────────┬─────────┬──────────┬───────────┐ ╭──────╮
    X_LT     &kp TAB         &kp Q   &kp W   &kp E      &kp R           &kp T            X_MT     &kp Y         &kp U           &kp I       &kp O     &kp P      &kp BSLH      X_RT
//├──────┤ ├───────────────┼───────┼───────┼──────────┼───────────────┼──────────────┤ ├──────┤ ├─────────────┼───────────────┼───────────┼─────────┼──────────┼───────────┤ ├──────┤
    X_LM     &mt LCTRL ESC   &hml LGUI A &hml LALT S &hml LSHFT D &hml LCTRL F &kp G X_MM &kp H &hmr RCTRL J &hmr RSHFT K &hmr RALT L &hmr RGUI SEMI &kp SQT X_RM
//├──────┤ ├───────────────┼───────┼───────┼──────────┼───────────────┼──────────────┤ ├──────┤ ├─────────────┼───────────────┼───────────┼─────────┼──────────┼───────────┤ ├──────┤
    X_LB     &kp LSHFT       &kp Z   &kp X   &kp C      &kp V           &kp B            X_MB     &kp N         &kp M           &kp COMMA   &kp DOT   &kp FSLH   &kp RSHFT     X_RB
//├──────┤ └───────────────┴───────┴───────┼──────────┼───────────────┼──────────────┤ ├──────┤ ├─────────────┼───────────────┼───────────┼─────────┴──────────┴───────────┘ ├──────┤
    X_LH                                     &kp LGUI   &lt SDL SPACE   &lt LWL BSPC     X_MH     &lt REL RET   &lt SUL SPACE   &kp RALT                                       X_RH
//╰──────╯                                 └──────────┴───────────────┴──────────────┘ ╰──────╯ └─────────────┴───────────────┴───────────┘                                  ╰──────╯
)

ZMK_LAYER(game, // 1
//╭──────╮ ┌───────────────┬───────┬───────┬──────────┬───────────────┬──────────────┐ ╭──────╮ ┌─────────────┬───────────────┬───────────┬─────────┬──────────┬───────────┐ ╭──────╮
    X_LT     &kp TAB         &kp Q   &kp W   &kp E      &kp R           &kp T            X_MT     &kp Y         &kp U           &kp I       &kp O     &kp P      &kp BSLH      X_RT  
//├──────┤ ├───────────────┼───────┼───────┼──────────┼───────────────┼──────────────┤ ├──────┤ ├─────────────┼───────────────┼───────────┼─────────┼──────────┼───────────┤ ├──────┤
    X_LM     &mt LCTRL ESC   &kp A   &kp S   &kp D      &kp F           &kp G            X_MM     &kp H         &kp J           &kp K       &kp L     &kp SEMI   &kp SQT       X_RM  
//├──────┤ ├───────────────┼───────┼───────┼──────────┼───────────────┼──────────────┤ ├──────┤ ├─────────────┼───────────────┼───────────┼─────────┼──────────┼───────────┤ ├──────┤
    X_LB     &kp LSHFT       &kp Z   &kp X   &kp C      &kp V           &kp B            X_MB     &kp N         &kp M           &kp COMMA   &kp DOT   &kp FSLH   &kp RSHFT     X_RB  
//├──────┤ └───────────────┴───────┴───────┼──────────┼───────────────┼──────────────┤ ├──────┤ ├─────────────┼───────────────┼───────────┼─────────┴──────────┴───────────┘ ├──────┤
    X_LH                                     &kp LGUI   &lt SDL SPACE   &lt LWL BSPC     X_MH     &lt REL RET   &lt SUL SPACE   &kp RALT                                       X_RH  
//╰──────╯                                 └──────────┴───────────────┴──────────────┘ ╰──────╯ └─────────────┴───────────────┴───────────┘                                  ╰──────╯
)

ZMK_LAYER(gamma, // 2
//╭──────╮ ┌───────────────┬────────────┬────────────┬─────────────┬───────────────┬──────────────┐ ╭──────╮ ┌─────────────┬───────────────┬─────────────┬────────────┬───────────────┬───────────┐ ╭──────╮
    X_LT     &kp TAB         &kp Q        &kp W        &kp E         &kp R           &kp T            X_MT     &kp Y         &kp U           &kp I         &kp O        &kp P           &kp BSLH      X_RT  
//├──────┤ ├───────────────┼────────────┼────────────┼─────────────┼───────────────┼──────────────┤ ├──────┤ ├─────────────┼───────────────┼─────────────┼────────────┼───────────────┼───────────┤ ├──────┤
    X_LM     &mt LCTRL ESC   &mt RGUI A   &mt RALT S   &mt RCTRL D   &mt LSHFT F     &kp G            X_MM     &kp H         &mt RSHFT J     &mt RCTRL K   &mt RALT L   &mt RGUI SEMI   &kp SQT       X_RM  
//├──────┤ ├───────────────┼────────────┼────────────┼─────────────┼───────────────┼──────────────┤ ├──────┤ ├─────────────┼───────────────┼─────────────┼────────────┼───────────────┼───────────┤ ├──────┤
    X_LB     &kp LSHFT       &kp Z        &kp X        &kp C         &kp V           &kp B            X_MB     &kp N         &kp M           &kp COMMA     &kp DOT      &kp FSLH        &kp RSHFT     X_RB  
//├──────┤ └───────────────┴────────────┴────────────┼─────────────┼───────────────┼──────────────┤ ├──────┤ ├─────────────┼───────────────┼─────────────┼────────────┴───────────────┴───────────┘ ├──────┤
    X_LH                                               &kp LGUI      &lt SDL SPACE   &lt LWL BSPC     X_MH     &lt REL RET   &lt SUL SPACE   &kp RALT                                                 X_RH  
//╰──────╯                                           └─────────────┴───────────────┴──────────────┘ ╰──────╯ └─────────────┴───────────────┴─────────────┘                                          ╰──────╯
)

ZMK_LAYER(delta, // 3
//╭──────╮ ┌───────────────┬────────────┬────────────┬─────────────┬───────────────┬──────────────┐ ╭──────╮ ┌─────────────┬───────────────┬─────────────┬────────────┬───────────────┬───────────┐ ╭──────╮
    X_LT     &kp TAB         &kp Q        &kp W        &kp E         &kp R           &kp T            X_MT     &kp Y         &kp U           &kp I         &kp O        &kp P           &kp BSLH      X_RT  
//├──────┤ ├───────────────┼────────────┼────────────┼─────────────┼───────────────┼──────────────┤ ├──────┤ ├─────────────┼───────────────┼─────────────┼────────────┼───────────────┼───────────┤ ├──────┤
    X_LM     &mt LCTRL ESC   &mt RGUI A   &mt RALT S   &mt RCTRL D   &mt LSHFT F     &kp G            X_MM     &kp H         &mt RSHFT J     &mt RCTRL K   &mt RALT L   &mt RGUI SEMI   &kp SQT       X_RM  
//├──────┤ ├───────────────┼────────────┼────────────┼─────────────┼───────────────┼──────────────┤ ├──────┤ ├─────────────┼───────────────┼─────────────┼────────────┼───────────────┼───────────┤ ├──────┤
    X_LB     &kp LSHFT       &kp Z        &kp X        &kp C         &kp V           &kp B            X_MB     &kp N         &kp M           &kp COMMA     &kp DOT      &kp FSLH        &kp RSHFT     X_RB  
//├──────┤ └───────────────┴────────────┴────────────┼─────────────┼───────────────┼──────────────┤ ├──────┤ ├─────────────┼───────────────┼─────────────┼────────────┴───────────────┴───────────┘ ├──────┤
    X_LH                                               &kp LGUI      &lt SDL SPACE   &lt LWL BSPC     X_MH     &lt REL RET   &lt SUL SPACE   &kp RALT                                                 X_RH  
//╰──────╯                                           └─────────────┴───────────────┴──────────────┘ ╰──────╯ └─────────────┴───────────────┴─────────────┘                                          ╰──────╯
)

ZMK_LAYER(epsilon, // 4
//╭──────╮ ┌───────────────┬────────────┬────────────┬─────────────┬───────────────┬──────────────┐ ╭──────╮ ┌─────────────┬───────────────┬─────────────┬────────────┬───────────────┬───────────┐ ╭──────╮
    X_LT     &kp TAB         &kp Q        &kp W        &kp E         &kp R           &kp T            X_MT     &kp Y         &kp U           &kp I         &kp O        &kp P           &kp BSLH      X_RT  
//├──────┤ ├───────────────┼────────────┼────────────┼─────────────┼───────────────┼──────────────┤ ├──────┤ ├─────────────┼───────────────┼─────────────┼────────────┼───────────────┼───────────┤ ├──────┤
    X_LM     &mt LCTRL ESC   &mt RGUI A   &mt RALT S   &mt RCTRL D   &mt LSHFT F     &kp G            X_MM     &kp H         &mt RSHFT J     &mt RCTRL K   &mt RALT L   &mt RGUI SEMI   &kp SQT       X_RM  
//├──────┤ ├───────────────┼────────────┼────────────┼─────────────┼───────────────┼──────────────┤ ├──────┤ ├─────────────┼───────────────┼─────────────┼────────────┼───────────────┼───────────┤ ├──────┤
    X_LB     &kp LSHFT       &kp Z        &kp X        &kp C         &kp V           &kp B            X_MB     &kp N         &kp M           &kp COMMA     &kp DOT      &kp FSLH        &kp RSHFT     X_RB  
//├──────┤ └───────────────┴────────────┴────────────┼─────────────┼───────────────┼──────────────┤ ├──────┤ ├─────────────┼───────────────┼─────────────┼────────────┴───────────────┴───────────┘ ├──────┤
    X_LH                                               &kp LGUI      &lt SDL SPACE   &lt LWL BSPC     X_MH     &lt REL RET   &lt SUL SPACE   &kp RALT                                                 X_RH  
//╰──────╯                                           └─────────────┴───────────────┴──────────────┘ ╰──────╯ └─────────────┴───────────────┴─────────────┘                                          ╰──────╯
)

ZMK_LAYER(zeta, // 5
//╭──────╮ ┌───────┬───────┬───────┬───────┬───────┬───────┐ ╭──────╮ ┌───────┬───────┬───────┬───────┬───────┬───────┐ ╭──────╮
    X_LT      ___     ___     ___     ___     ___     ___      X_MT      ___     ___     ___     ___     ___     ___      X_RT  
//├──────┤ ├───────┼───────┼───────┼───────┼───────┼───────┤ ├──────┤ ├───────┼───────┼───────┼───────┼───────┼───────┤ ├──────┤
    X_LM      ___     ___     ___     ___     ___     ___      X_MM      ___     ___     ___     ___     ___     ___      X_RM  
//├──────┤ ├───────┼───────┼───────┼───────┼───────┼───────┤ ├──────┤ ├───────┼───────┼───────┼───────┼───────┼───────┤ ├──────┤
    X_LB      ___     ___     ___     ___     ___     ___      X_MB      ___     ___     ___     ___     ___     ___      X_RB  
//├──────┤ └───────┴───────┴───────┼───────┼───────┼───────┤ ├──────┤ ├───────┼───────┼───────┼───────┴───────┴───────┘ ├──────┤
    X_LH                              ___     ___     ___      X_MH      ___     ___     ___                              X_RH  
//╰──────╯                         └───────┴───────┴───────┘ ╰──────╯ └───────┴───────┴───────┘                         ╰──────╯
)

ZMK_LAYER(spacedown, // 6
//╭──────╮ ┌─────────────────┬───────────────────┬───────────────────┬─────────────────┬─────────────────┬──────────────┐ ╭──────╮ ┌──────────┬───────────┬───────────┬───────────┬────────┬──────────┐ ╭──────╮
    X_LT     &rgb_ug RGB_TOG   &ext_power EP_TOG   &ext_power EP_OFF   &out OUT_USB      &out OUT_BLE      &out OUT_TOG     X_MT      ___        ___         ___         ___         ___     &kp BSPC     X_RT  
//├──────┤ ├─────────────────┼───────────────────┼───────────────────┼─────────────────┼─────────────────┼──────────────┤ ├──────┤ ├──────────┼───────────┼───────────┼───────────┼────────┼──────────┤ ├──────┤
    X_LM     &rgb_ug RGB_EFF   &rgb_ug RGB_HUI     &rgb_ug RGB_SAI     &rgb_ug RGB_BRI   &rgb_ug RGB_SPI    ___             X_MM     &kp LEFT   &kp DOWN    &kp UP      &kp RIGHT    ___      ___         X_RM  
//├──────┤ ├─────────────────┼───────────────────┼───────────────────┼─────────────────┼─────────────────┼──────────────┤ ├──────┤ ├──────────┼───────────┼───────────┼───────────┼────────┼──────────┤ ├──────┤
    X_LB     &rgb_ug RGB_EFR   &rgb_ug RGB_HUD     &rgb_ug RGB_SAD     &rgb_ug RGB_BRD   &rgb_ug RGB_SPD    ___             X_MB     &kp HOME   &kp PG_DN   &kp PG_UP   &kp END      ___      ___         X_RB  
//├──────┤ └─────────────────┴───────────────────┴───────────────────┼─────────────────┼─────────────────┼──────────────┤ ├──────┤ ├──────────┼───────────┼───────────┼───────────┴────────┴──────────┘ ├──────┤
    X_LH                                                                ___               ___               ___             X_MH      ___        ___         ___                                          X_RH  
//╰──────╯                                                           └─────────────────┴─────────────────┴──────────────┘ ╰──────╯ └──────────┴───────────┴───────────┘                                 ╰──────╯
)

ZMK_LAYER(spaceup, // 7
//╭──────╮ ┌─────────────────┬─────────────────┬─────────────────┬─────────────────┬─────────────────┬────────┐ ╭──────╮ ┌──────────┬───────────┬───────────┬───────────┬────────┬─────────────────┐ ╭──────╮
    X_LT     &rgb_ug RGB_TOG   &kp N1            &kp N2            &kp N3            &kp N4            &kp N5     X_MT     &kp N6     &kp N7      &kp N8      &kp N9      &kp N0   &kp DEL             X_RT  
//├──────┤ ├─────────────────┼─────────────────┼─────────────────┼─────────────────┼─────────────────┼────────┤ ├──────┤ ├──────────┼───────────┼───────────┼───────────┼────────┼─────────────────┤ ├──────┤
    X_LM     &rgb_ug RGB_EFF   &rgb_ug RGB_HUI   &rgb_ug RGB_SAI   &rgb_ug RGB_BRI   &rgb_ug RGB_SPI    ___       X_MM     &kp LEFT   &kp DOWN    &kp UP      &kp RIGHT    ___     &rgb_ug RGB_TOG     X_RM  
//├──────┤ ├─────────────────┼─────────────────┼─────────────────┼─────────────────┼─────────────────┼────────┤ ├──────┤ ├──────────┼───────────┼───────────┼───────────┼────────┼─────────────────┤ ├──────┤
    X_LB     &rgb_ug RGB_EFR   &rgb_ug RGB_HUD   &rgb_ug RGB_SAD   &rgb_ug RGB_BRD   &rgb_ug RGB_SPD    ___       X_MB     &kp HOME   &kp PG_DN   &kp PG_UP   &kp END      ___      ___                X_RB  
//├──────┤ └─────────────────┴─────────────────┴─────────────────┼─────────────────┼─────────────────┼────────┤ ├──────┤ ├──────────┼───────────┼───────────┼───────────┴────────┴─────────────────┘ ├──────┤
    X_LH                                                            ___               ___               ___       X_MH      ___        ___         ___                                                 X_RH  
//╰──────╯                                                       └─────────────────┴─────────────────┴────────┘ ╰──────╯ └──────────┴───────────┴───────────┘                                        ╰──────╯
)

ZMK_LAYER(lower, // 8
//╭──────╮ ┌─────────┬────────┬────────┬────────┬────────┬─────────┐ ╭──────╮ ┌──────────────┬────────┬────────┬────────┬──────────────┬─────────────────┐ ╭──────╮
    X_LT      ___      &kp N1   &kp N2   &kp N3   &kp N4   &kp N5      X_MT     &kp N6         &kp N7   &kp N8   &kp N9   &kp N0         &kp BSPC            X_RT  
//├──────┤ ├─────────┼────────┼────────┼────────┼────────┼─────────┤ ├──────┤ ├──────────────┼────────┼────────┼────────┼──────────────┼─────────────────┤ ├──────┤
    X_LM     &kp F11   &kp F1   &kp F2   &kp F3   &kp F4   &kp F5      X_MM     &kp KP_PLUS    &kp N4   &kp N5   &kp N6   &kp KP_ENTER   &kp KP_MULTIPLY     X_RM  
//├──────┤ ├─────────┼────────┼────────┼────────┼────────┼─────────┤ ├──────┤ ├──────────────┼────────┼────────┼────────┼──────────────┼─────────────────┤ ├──────┤
    X_LB     &kp F12   &kp F6   &kp F7   &kp F8   &kp F9   &kp F10     X_MB     &kp KP_MINUS   &kp N1   &kp N2   &kp N3   &kp KP_ENTER   &kp KP_DIVIDE       X_RB  
//├──────┤ └─────────┴────────┴────────┼────────┼────────┼─────────┤ ├──────┤ ├──────────────┼────────┼────────┼────────┴──────────────┴─────────────────┘ ├──────┤
    X_LH                                  ___      ___      ___        X_MH      ___            ___      ___                                                 X_RH  
//╰──────╯                             └────────┴────────┴─────────┘ ╰──────╯ └──────────────┴────────┴────────┘                                           ╰──────╯
)

ZMK_LAYER(raise, // 9
//╭──────╮ ┌───────┬──────────┬────────┬──────────┬──────────┬───────────┐ ╭──────╮ ┌───────────┬───────────┬───────────┬──────────┬──────────┬──────────┐ ╭──────╮
    X_LT      ___     ___        ___      ___        ___        ___          X_MT     &kp TILDE   &kp UNDER   &kp PLUS    &kp LBRC   &kp RBRC   &kp PIPE     X_RT  
//├──────┤ ├───────┼──────────┼────────┼──────────┼──────────┼───────────┤ ├──────┤ ├───────────┼───────────┼───────────┼──────────┼──────────┼──────────┤ ├──────┤
    X_LM      ___    &kp EXCL   &kp AT   &kp HASH   &kp DLLR   &kp PRCNT     X_MM     &kp CARET   &kp AMPS    &kp ASTRK   &kp LPAR   &kp RPAR   &kp BSPC     X_RM  
//├──────┤ ├───────┼──────────┼────────┼──────────┼──────────┼───────────┤ ├──────┤ ├───────────┼───────────┼───────────┼──────────┼──────────┼──────────┤ ├──────┤
    X_LB      ___     ___        ___      ___        ___        ___          X_MB     &kp GRAVE   &kp MINUS   &kp EQUAL   &kp LBKT   &kp RBKT   &kp BSLH     X_RB  
//├──────┤ └───────┴──────────┴────────┼──────────┼──────────┼───────────┤ ├──────┤ ├───────────┼───────────┼───────────┼──────────┴──────────┴──────────┘ ├──────┤
    X_LH                                  ___        ___        ___          X_MH      ___         ___         ___                                           X_RH  
//╰──────╯                             └──────────┴──────────┴───────────┘ ╰──────╯ └───────────┴───────────┴───────────┘                                  ╰──────╯
)

ZMK_LAYER(realspace, // 10
//╭──────╮ ┌─────────────┬───────┬───────┬───────┬───────┬───────┐ ╭──────╮ ┌───────┬───────┬───────┬───────┬───────┬─────────────┐ ╭──────╮
    X_LT      ___           ___     ___     ___     ___     ___      X_MT      ___     ___     ___     ___     ___    &kp N5          X_RT  
//├──────┤ ├─────────────┼───────┼───────┼───────┼───────┼───────┤ ├──────┤ ├───────┼───────┼───────┼───────┼───────┼─────────────┤ ├──────┤
    X_LM     &sys_reset     ___     ___     ___     ___     ___      X_MM      ___     ___     ___     ___     ___    &sys_reset      X_RM  
//├──────┤ ├─────────────┼───────┼───────┼───────┼───────┼───────┤ ├──────┤ ├───────┼───────┼───────┼───────┼───────┼─────────────┤ ├──────┤
    X_LB     &bootloader    ___     ___     ___     ___     ___      X_MB      ___     ___     ___     ___     ___    &bootloader     X_RB  
//├──────┤ └─────────────┴───────┴───────┼───────┼───────┼───────┤ ├──────┤ ├───────┼───────┼───────┼───────┴───────┴─────────────┘ ├──────┤
    X_LH                                    ___     ___     ___      X_MH      ___     ___     ___                                    X_RH  
//╰──────╯                               └───────┴───────┴───────┘ ╰──────╯ └───────┴───────┴───────┘                               ╰──────╯
)

ZMK_LAYER(adjust, // 11
//╭──────╮ ┌─────────┬─────────┬─────────┬─────────┬─────────┬─────────┐ ╭──────╮ ┌─────────────┬───────┬───────┬───────┬───────┬────────┐ ╭──────╮
    X_LT     &to DFL   &to GML   &to GAL   &to DTL   &to EPL   &to ZEL     X_MT      &soft_off     ___     ___     ___     ___    &kp N6     X_RT  
//├──────┤ ├─────────┼─────────┼─────────┼─────────┼─────────┼─────────┤ ├──────┤ ├─────────────┼───────┼───────┼───────┼───────┼────────┤ ├──────┤
    X_LM      ___       ___       ___       ___       ___      &to DEF     X_MM      ___           ___     ___     ___     ___     ___       X_RM  
//├──────┤ ├─────────┼─────────┼─────────┼─────────┼─────────┼─────────┤ ├──────┤ ├─────────────┼───────┼───────┼───────┼───────┼────────┤ ├──────┤
    X_LB      ___       ___       ___       ___       ___       ___        X_MB      ___           ___     ___     ___     ___     ___       X_RB  
//├──────┤ └─────────┴─────────┴─────────┼─────────┼─────────┼─────────┤ ├──────┤ ├─────────────┼───────┼───────┼───────┴───────┴────────┘ ├──────┤
    X_LH                                    ___       ___       ___        X_MH      ___           ___     ___                               X_RH  
//╰──────╯                               └─────────┴─────────┴─────────┘ ╰──────╯ └─────────────┴───────┴───────┘                          ╰──────╯
)

ZMK_LAYER(subspace, // 12
//╭──────╮ ┌─────────────────┬───────┬───────┬──────────────┬──────────────┬──────────────┐ ╭──────╮ ╭────────────┬────────────┬────────────┬────────────┬─────────┬───────╮ ╭──────╮
    X_LT     &rgb_ug RGB_TOG    ___     ___    &out OUT_USB   &out OUT_BLE   &out OUT_TOG     X_MT     U_WH_L       U_WH_D       U_MS_U        U_WH_U      U_WH_R     ___      X_RT  
//├──────┤ ├─────────────────┼───────┼───────┼──────────────┼──────────────┼──────────────┤ ├──────┤ ├────────────┼────────────┼────────────┼────────────┼─────────┼───────┤ ├──────┤
    X_LM     _BT_SEL_KEYS_                                                                    X_MM     ___          U_MS_L       U_MS_D        U_MS_R      ___        ___      X_RM  
//├──────┤ ├─────────────────┼───────┼───────┼──────────────┼──────────────┼──────────────┤ ├──────┤ ├────────────┼────────────┼────────────┼────────────┼─────────┼───────┤ ├──────┤
    X_LB     _BT_SEL_KEYS_2_                                                                  X_MB     ___          &mkp MB4     &mkp MCLK     &mkp MB5    ___        ___      X_RB  
//├──────┤ └─────────────────┴───────┴───────┼──────────────┼──────────────┼──────────────┤ ├──────┤ ├────────────┼────────────┼────────────┴──────────────────────┴───────╯ ├──────┤
    X_LH                                        ___            ___            ___             X_MH     &mkp LCLK    &mkp RCLK     ___                                          X_RH  
//╰──────╯                                   └──────────────┴──────────────┴──────────────┘ ╰──────╯ ╰────────────┴────────────┴────────────╯                                ╰──────╯
)

ZMK_LAYER(hyperspace, // 13
//╭──────╮ ┌─────────────────┬─────────────────┬─────────────────┬─────────────────┬─────────────────┬───────┐ ╭──────╮ ┌──────────┬───────────┬───────────┬───────────┬───────┬────────┐ ╭──────╮
    X_LT     &rgb_ug RGB_TOG    ___               ___               ___               ___               ___      X_MT      ___        ___         ___         ___         ___    &kp N8     X_RT  
//├──────┤ ├─────────────────┼─────────────────┼─────────────────┼─────────────────┼─────────────────┼───────┤ ├──────┤ ├──────────┼───────────┼───────────┼───────────┼───────┼────────┤ ├──────┤
    X_LM     &rgb_ug RGB_EFF   &rgb_ug RGB_HUI   &rgb_ug RGB_SAI   &rgb_ug RGB_BRI   &rgb_ug RGB_SPI    ___      X_MM     &kp LEFT   &kp DOWN    &kp UP      &kp RIGHT    ___     ___       X_RM  
//├──────┤ ├─────────────────┼─────────────────┼─────────────────┼─────────────────┼─────────────────┼───────┤ ├──────┤ ├──────────┼───────────┼───────────┼───────────┼───────┼────────┤ ├──────┤
    X_LB     &rgb_ug RGB_EFR   &rgb_ug RGB_HUD   &rgb_ug RGB_SAD   &rgb_ug RGB_BRD   &rgb_ug RGB_SPD    ___      X_MB     &kp HOME   &kp PG_DN   &kp PG_UP   &kp END      ___     ___       X_RB  
//├──────┤ └─────────────────┴─────────────────┴─────────────────┼─────────────────┼─────────────────┼───────┤ ├──────┤ ├──────────┼───────────┼───────────┼───────────┴───────┴────────┘ ├──────┤
    X_LH                                                            ___               ___               ___      X_MH      ___        ___         ___                                       X_RH  
//╰──────╯                                                       └─────────────────┴─────────────────┴───────┘ ╰──────╯ └──────────┴───────────┴───────────┘                              ╰──────╯
)

ZMK_LAYER(knownspace, // 14
//╭──────╮ ┌─────────┬───────┬───────┬───────┬───────┬───────┐ ╭──────╮ ┌───────┬───────┬───────┬───────┬───────┬───────┐ ╭──────╮
    X_LT      ___       ___     ___     ___     ___     ___      X_MT      ___     ___     ___     ___     ___     ___      X_RT  
//├──────┤ ├─────────┼───────┼───────┼───────┼───────┼───────┤ ├──────┤ ├───────┼───────┼───────┼───────┼───────┼───────┤ ├──────┤
    X_LM      ___       ___     ___     ___     ___     ___      X_MM      ___     ___     ___     ___     ___     ___      X_RM  
//├──────┤ ├─────────┼───────┼───────┼───────┼───────┼───────┤ ├──────┤ ├───────┼───────┼───────┼───────┼───────┼───────┤ ├──────┤
    X_LB      ___       ___     ___     ___     ___     ___      X_MB      ___     ___     ___     ___     ___     ___      X_RB  
//├──────┤ └─────────┴───────┴───────┼───────┼───────┼───────┤ ├──────┤ ├───────┼───────┼───────┼───────┴───────┴───────┘ ├──────┤
    X_LH                                ___     ___     ___      X_MH      ___     ___     ___                              X_RH  
//╰──────╯                           └───────┴───────┴───────┘ ╰──────╯ └───────┴───────┴───────┘                         ╰──────╯
)

ZMK_LAYER(cyberspace, // 15
//╭──────╮ ┌─────────┬───────┬───────┬───────┬───────┬───────┐ ╭──────╮ ┌───────┬───────┬───────┬───────┬───────┬───────┐ ╭──────╮
    X_LT      ___       ___     ___     ___     ___     ___      X_MT      ___     ___     ___     ___     ___     ___      X_RT  
//├──────┤ ├─────────┼───────┼───────┼───────┼───────┼───────┤ ├──────┤ ├───────┼───────┼───────┼───────┼───────┼───────┤ ├──────┤
    X_LM      ___       ___     ___     ___     ___     ___      X_MM      ___     ___     ___     ___     ___     ___      X_RM  
//├──────┤ ├─────────┼───────┼───────┼───────┼───────┼───────┤ ├──────┤ ├───────┼───────┼───────┼───────┼───────┼───────┤ ├──────┤
    X_LB      ___       ___     ___     ___     ___     ___      X_MB      ___     ___     ___     ___     ___     ___      X_RB  
//├──────┤ └─────────┴───────┴───────┼───────┼───────┼───────┤ ├──────┤ ├───────┼───────┼───────┼───────┴───────┴───────┘ ├──────┤
    X_LH                                ___     ___     ___      X_MH      ___     ___     ___                              X_RH  
//╰──────╯                           └───────┴───────┴───────┘ ╰──────╯ └───────┴───────┴───────┘                         ╰──────╯
)

ZMK_LAYER(slipspace, // 16
//╭──────╮ ┌─────────┬───────┬───────┬───────┬───────┬───────┐ ╭──────╮ ┌───────┬───────┬───────┬───────┬───────┬───────┐ ╭──────╮
    X_LT      ___       ___     ___     ___     ___     ___      X_MT      ___     ___     ___     ___     ___     ___      X_RT  
//├──────┤ ├─────────┼───────┼───────┼───────┼───────┼───────┤ ├──────┤ ├───────┼───────┼───────┼───────┼───────┼───────┤ ├──────┤
    X_LM      ___       ___     ___     ___     ___     ___      X_MM      ___     ___     ___     ___     ___     ___      X_RM  
//├──────┤ ├─────────┼───────┼───────┼───────┼───────┼───────┤ ├──────┤ ├───────┼───────┼───────┼───────┼───────┼───────┤ ├──────┤
    X_LB      ___       ___     ___     ___     ___     ___      X_MB      ___     ___     ___     ___     ___     ___      X_RB  
//├──────┤ └─────────┴───────┴───────┼───────┼───────┼───────┤ ├──────┤ ├───────┼───────┼───────┼───────┴───────┴───────┘ ├──────┤
    X_LH                                ___     ___     ___      X_MH      ___     ___     ___                              X_RH  
//╰──────╯                           └───────┴───────┴───────┘ ╰──────╯ └───────┴───────┴───────┘                         ╰──────╯
)

ZMK_LAYER(foldspace, // 17
//╭──────╮ ┌─────────┬───────┬───────┬───────┬───────┬───────┐ ╭──────╮ ┌───────┬───────┬───────┬───────┬───────┬───────┐ ╭──────╮
    X_LT      ___       ___     ___     ___     ___     ___      X_MT      ___     ___     ___     ___     ___     ___      X_RT  
//├──────┤ ├─────────┼───────┼───────┼───────┼───────┼───────┤ ├──────┤ ├───────┼───────┼───────┼───────┼───────┼───────┤ ├──────┤
    X_LM      ___       ___     ___     ___     ___     ___      X_MM      ___     ___     ___     ___     ___     ___      X_RM  
//├──────┤ ├─────────┼───────┼───────┼───────┼───────┼───────┤ ├──────┤ ├───────┼───────┼───────┼───────┼───────┼───────┤ ├──────┤
    X_LB      ___       ___     ___     ___     ___     ___      X_MB      ___     ___     ___     ___     ___     ___      X_RB  
//├──────┤ └─────────┴───────┴───────┼───────┼───────┼───────┤ ├──────┤ ├───────┼───────┼───────┼───────┴───────┴───────┘ ├──────┤
    X_LH                                ___     ___     ___      X_MH      ___     ___     ___                              X_RH  
//╰──────╯                           └───────┴───────┴───────┘ ╰──────╯ └───────┴───────┴───────┘                         ╰──────╯
)

ZMK_LAYER(blackhole, // 18
//╭──────╮ ┌─────────┬───────┬───────┬───────┬───────┬───────┐ ╭──────╮ ┌───────┬───────┬───────┬───────┬───────┬───────┐ ╭──────╮
    X_LT      ___       ___     ___     ___     ___     ___      X_MT      ___     ___     ___     ___     ___     ___      X_RT  
//├──────┤ ├─────────┼───────┼───────┼───────┼───────┼───────┤ ├──────┤ ├───────┼───────┼───────┼───────┼───────┼───────┤ ├──────┤
    X_LM      ___       ___     ___     ___     ___     ___      X_MM      ___     ___     ___     ___     ___     ___      X_RM  
//├──────┤ ├─────────┼───────┼───────┼───────┼───────┼───────┤ ├──────┤ ├───────┼───────┼───────┼───────┼───────┼───────┤ ├──────┤
    X_LB      ___       ___     ___     ___     ___     ___      X_MB      ___     ___     ___     ___     ___     ___      X_RB  
//├──────┤ └─────────┴───────┴───────┼───────┼───────┼───────┤ ├──────┤ ├───────┼───────┼───────┼───────┴───────┴───────┘ ├──────┤
    X_LH                                ___     ___     ___      X_MH      ___     ___     ___                              X_RH  
//╰──────╯                           └───────┴───────┴───────┘ ╰──────╯ └───────┴───────┴───────┘                         ╰──────╯
)

ZMK_LAYER(whitehole, // 19
//╭──────╮ ┌─────────┬───────┬───────┬───────┬───────┬───────┐ ╭──────╮ ┌───────┬───────┬───────┬───────┬───────┬───────┐ ╭──────╮
    X_LT      ___       ___     ___     ___     ___     ___      X_MT      ___     ___     ___     ___     ___     ___      X_RT  
//├──────┤ ├─────────┼───────┼───────┼───────┼───────┼───────┤ ├──────┤ ├───────┼───────┼───────┼───────┼───────┼───────┤ ├──────┤
    X_LM      ___       ___     ___     ___     ___     ___      X_MM      ___     ___     ___     ___     ___     ___      X_RM  
//├──────┤ ├─────────┼───────┼───────┼───────┼───────┼───────┤ ├──────┤ ├───────┼───────┼───────┼───────┼───────┼───────┤ ├──────┤
    X_LB      ___       ___     ___     ___     ___     ___      X_MB      ___     ___     ___     ___     ___     ___      X_RB  
//├──────┤ └─────────┴───────┴───────┼───────┼───────┼───────┤ ├──────┤ ├───────┼───────┼───────┼───────┴───────┴───────┘ ├──────┤
    X_LH                                ___     ___     ___      X_MH      ___     ___     ___                              X_RH  
//╰──────╯                           └───────┴───────┴───────┘ ╰──────╯ └───────┴───────┴───────┘                         ╰──────╯
)

ZMK_LAYER(warp, // 20
//╭──────╮ ┌─────────┬───────┬───────┬───────┬───────┬───────┐ ╭──────╮ ┌───────┬───────┬───────┬───────┬───────┬───────┐ ╭──────╮
    X_LT      ___       ___     ___     ___     ___     ___      X_MT      ___     ___     ___     ___     ___     ___      X_RT  
//├──────┤ ├─────────┼───────┼───────┼───────┼───────┼───────┤ ├──────┤ ├───────┼───────┼───────┼───────┼───────┼───────┤ ├──────┤
    X_LM      ___       ___     ___     ___     ___     ___      X_MM      ___     ___     ___     ___     ___     ___      X_RM  
//├──────┤ ├─────────┼───────┼───────┼───────┼───────┼───────┤ ├──────┤ ├───────┼───────┼───────┼───────┼───────┼───────┤ ├──────┤
    X_LB      ___       ___     ___     ___     ___     ___      X_MB      ___     ___     ___     ___     ___     ___      X_RB  
//├──────┤ └─────────┴───────┴───────┼───────┼───────┼───────┤ ├──────┤ ├───────┼───────┼───────┼───────┴───────┴───────┘ ├──────┤
    X_LH                                ___     ___     ___      X_MH      ___     ___     ___                              X_RH  
//╰──────╯                           └───────┴───────┴───────┘ ╰──────╯ └───────┴───────┴───────┘                         ╰──────╯
)

ZMK_LAYER(base,
//╭──────╮ ╭────────┬─────────────┬─────────────┬─────────────┬───────────────┬────────────╮ ╭──────╮ ╭─────────────┬─────────────┬─────────────┬─────────────┬─────────────┬───────╮ ╭──────╮
    X_LT      ___     &kp Q         &kp W         &kp F          &kp P          &kp B          X_MT     &kp J         &kp L         &kp U         &kp Y         &kp SQT        ___      X_RT
//├──────┤ ├────────┼─────────────┼─────────────┼─────────────┼───────────────┼────────────┤ ├──────┤ ├─────────────┼─────────────┼─────────────┼─────────────┼─────────────┼───────┤ ├──────┤
    X_LM      ___     &hml LGUI A   &hml LALT R   &hml LSHFT S   &hml LCTRL T   &kp G          X_MM     &kp M         &hmr LCTRL N  &hmr RSHFT E  &hmr LALT I   &hmr LGUI O    ___      X_RM
//├──────┤ ├────────┼─────────────┼─────────────┼─────────────┼───────────────┼────────────┤ ├──────┤ ├─────────────┼─────────────┼─────────────┼─────────────┼─────────────┼───────┤ ├──────┤
    X_LB      ___     &kp Z         &kp X         &kp C          &kp D          &kp V          X_MB     &kp K         &kp H         &comma_morph  &dot_morph    &qexcl         ___      X_RB
//├──────┤ ╰────────┴─────────────┼─────────────┴─────────────┼───────────────┼────────────┤ ├──────┤ ├─────────────┼─────────────┼─────────────┴───────────────────────────┴───────╯ ├──────┤
    X_LH                                           ___          &lt_spc NAV 0   &lt FN RET     X_MH     SMART_NUM     &smart_shft   ___                                                 X_RH
//╰──────╯                                      ╰─────────────┴───────────────┴────────────╯ ╰──────╯ ╰─────────────┴─────────────┴─────────────╯                                     ╰──────╯
)

ZMK_LAYER(nav,
//╭──────╮ ╭────────┬───────────┬───────────┬─────────────┬────────────┬──────╮ ╭──────╮ ╭────────────┬───────────┬───────────┬────────────┬─────────┬───────╮ ╭──────╮
    X_LT      ___     ___         ___         &kp LS(TAB)   &swapper     ___      X_MT     &kp PG_UP    NAV_BSPC    NAV_UP      NAV_DEL      ___        ___      X_RT
//├──────┤ ├────────┼───────────┼───────────┼─────────────┼────────────┼──────┤ ├──────┤ ├────────────┼───────────┼───────────┼────────────┼─────────┼───────┤ ├──────┤
    X_LM      ___     &sk LGUI    &sk LALT    &sk LSHFT     &sk LCTRL    ___      X_MM     &kp PG_DN    NAV_LEFT    NAV_DOWN    NAV_RIGHT    &kp RET    ___      X_RM
//├──────┤ ├────────┼───────────┼───────────┼─────────────┼────────────┼──────┤ ├──────┤ ├────────────┼───────────┼───────────┼────────────┼─────────┼───────┤ ├──────┤
    X_LB      ___     ___         ___         ___           ___          ___      X_MB     &kp INS      &kp TAB     &kp LT      &kp GT       ___        ___      X_RB
//├──────┤ ╰────────┴───────────┼───────────┴─────────────┼────────────┼──────┤ ├──────┤ ├────────────┼───────────┼───────────┴──────────────────────┴───────╯ ├──────┤
    X_LH                                      ___           ___          ___      X_MH     ___          CANCEL      ___                                          X_RH
//╰──────╯                                  ╰─────────────┴────────────┴──────╯ ╰──────╯ ╰────────────┴───────────┴───────────╯                                ╰──────╯
)

ZMK_LAYER(fn,
//╭──────╮ ╭───────┬────────────────┬────────────────┬─────────────────┬─────────────────┬───────╮ ╭──────╮ ╭─────────────┬─────────────┬─────────────┬─────────────┬────────────┬───────╮ ╭──────╮
    X_LT      ___    &kp F12           &kp F7           &kp F8            &kp F9            ___      X_MT     ___           &kp C_PREV    &kp C_VOL_UP  &kp C_NEXT    &win_sleep    ___      X_RT
//├──────┤ ├───────┼────────────────┼────────────────┼─────────────────┼─────────────────┼───────┤ ├──────┤ ├─────────────┼─────────────┼─────────────┼─────────────┼────────────┼───────┤ ├──────┤
    X_LM      ___    &hml LGUI F11     &hml LALT F4     &hml LSHFT F5     &hml LCTRL F6     ___      X_MM     ___           DSK_PREV      VOL_DOWN      DSK_NEXT      ___           ___      X_RM
//├──────┤ ├───────┼────────────────┼────────────────┼─────────────────┼─────────────────┼───────┤ ├──────┤ ├─────────────┼─────────────┼─────────────┼─────────────┼────────────┼───────┤ ├──────┤
    X_LB      ___    &kp F10           &kp F1           &kp F2            &kp F3            ___      X_MB     PIN_APP       PIN_WIN       DSK_MGR       ___           ___           ___      X_RB
//├──────┤ ╰───────┴────────────────┼────────────────┴─────────────────┼─────────────────┼───────┤ ├──────┤ ├─────────────┼─────────────┼─────────────┴──────────────────────────┴───────╯ ├──────┤
    X_LH                                                ___               ___               ___      X_MH     &kp C_MUTE    &kp C_PP      ___                                                X_RH
//╰──────╯                                           ╰─────────────────┴─────────────────┴───────╯ ╰──────╯ ╰─────────────┴─────────────┴─────────────╯                                    ╰──────╯
)

ZMK_LAYER(num,
//╭──────╮ ╭────────┬─────────────┬─────────────┬─────────────┬─────────────┬──────╮ ╭──────╮ ╭──────┬──────┬───────┬───────┬───────┬───────╮ ╭──────╮
    X_LT      ___     ___           &kp N7        &kp N8        &kp N9        ___      X_MT     ___    ___     ___     ___     ___     ___      X_RT
//├──────┤ ├────────┼─────────────┼─────────────┼─────────────┼─────────────┼──────┤ ├──────┤ ├──────┼──────┼───────┼───────┼───────┼───────┤ ├──────┤
    X_LM      ___     &hml LGUI N0  &hml LALT N4  &hml LSHFT N5 &hml LCTRL N6 ___      X_MM     ___    ___     ___     ___     ___     ___      X_RM
//├──────┤ ├────────┼─────────────┼─────────────┼─────────────┼─────────────┼──────┤ ├──────┤ ├──────┼──────┼───────┼───────┼───────┼───────┤ ├──────┤
    X_LB      ___     ___           &kp N1        &kp N2        &kp N3        ___      X_MB     ___    ___     ___     ___     ___     ___      X_RB
//├──────┤ ╰────────┴─────────────┼─────────────┴─────────────┼─────────────┼──────┤ ├──────┤ ├──────┼──────┼───────┴───────────────┴───────╯ ├──────┤
    X_LH                                           ___           ___          ___      X_MH     ___    ___     ___                              X_RH
//╰──────╯                                      ╰─────────────┴─────────────┴──────╯ ╰──────╯ ╰──────┴──────┴───────╯                         ╰──────╯
)

ZMK_LAYER(sys,
//╭──────╮ ╭───────┬───────┬───────┬──────┬──────┬─────────────╮ ╭──────╮ ╭─────────────┬───────┬───────┬───────┬───────┬───────╮ ╭──────╮
    X_LT                    _BT_SEL_KEYS_                          X_MT     &to DFL        ___     ___     ___     ___     ___      X_RT
//├──────┤ ├───────┼───────┼───────┼──────┼──────┼─────────────┤ ├──────┤ ├─────────────┼───────┼───────┼───────┼───────┼───────┤ ├──────┤
    X_LM      ___     ___     ___    ___    ___    &bootloader     X_MM     &bootloader    ___     ___     ___     ___     ___      X_RM
//├──────┤ ├───────┼───────┼───────┼──────┼──────┼─────────────┤ ├──────┤ ├─────────────┼───────┼───────┼───────┼───────┼───────┤ ├──────┤
    X_LB      ___     ___     ___    ___    ___    &sys_reset      X_MB     &sys_reset     ___     ___     ___     ___     ___      X_RB
//├──────┤ ╰───────┴───────┼───────┴──────┼──────┼─────────────┤ ├──────┤ ├─────────────┼───────┼───────┴───────────────┴───────╯ ├──────┤
    X_LH                             ___    ___    ___             X_MH     ___            ___     ___                              X_RH
//╰──────╯                         ╰──────┴──────┴─────────────╯ ╰──────╯ ╰─────────────┴───────┴───────╯                         ╰──────╯
)

ZMK_LAYER(mouse,
//╭──────╮ ╭────────┬────────────┬────────────┬────────────┬────────────┬────────────╮ ╭──────╮ ╭────────────┬────────────┬────────────┬────────────┬─────────┬───────╮ ╭──────╮
    X_LT      ___     ___          ___          ___          ___          ___            X_MT     U_WH_L       U_WH_D       U_MS_U        U_WH_U      U_WH_R     ___      X_RT
//├──────┤ ├────────┼────────────┼────────────┼────────────┼────────────┼────────────┤ ├──────┤ ├────────────┼────────────┼────────────┼────────────┼─────────┼───────┤ ├──────┤
    X_LM      ___     ___          ___          ___          ___          ___            X_MM     ___          U_MS_L       U_MS_D        U_MS_R      ___        ___      X_RM
//├──────┤ ├────────┼────────────┼────────────┼────────────┼────────────┼────────────┤ ├──────┤ ├────────────┼────────────┼────────────┼────────────┼─────────┼───────┤ ├──────┤
    X_LB      ___     ___          ___          ___          ___          ___            X_MB     ___          &mkp MB4     &mkp MCLK     &mkp MB5    ___        ___      X_RB
//├──────┤ ╰────────┴────────────┼────────────┴────────────┼────────────┼────────────┤ ├──────┤ ├────────────┼────────────┼────────────┴──────────────────────┴───────╯ ├──────┤
    X_LH                                        ___          ___          ___            X_MH     &mkp LCLK    &mkp RCLK     ___                                          X_RH
//╰──────╯                                    ╰────────────┴────────────┴────────────╯ ╰──────╯ ╰────────────┴────────────┴────────────╯                                ╰──────╯
)

/* vim: set ft=c tw=174: */
