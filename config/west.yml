## config/west.yml
```yaml
manifest:
  remotes:
    - name: zmkfirmware
      url-base: https://github.com/zmkfirmware
    - name: r2d2rogers
      url-base: https://github.com/r2d2rogers
    - name: DiogoDoreto
      url-base: https://github.com/DiogoDoreto
    - name: petejohanson
      url-base: https://github.com/petejohanson
    - name: urob
      url-base: https://github.com/urob
  projects:
    - name: zmk
      remote: urob
      revision: going-modular
      import: app/west.yml
    - name: zmk-helpers
      remote: urob
      revision: main
    - name: zmk-auto-layer
      remote: urob
      revision: main
    - name: zmk-tri-state
      remote: urob
      revision: main
    # - name: r2d2rogers
    #   remote: r2d2rogers
    #   revision: main
    #   import: app/west.yml
    # - name: petejohanson
    #   remote: petejohanson
    #   revision: stephen/split-encoder
    #   import: app/west.yml
    # - name: DiogoDoreto
    #   remote: DiogoDoreto
    #   revision: waterfowl-encoders
    #   import: app/west.yml
  self:
    path: config
```
