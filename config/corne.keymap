
#include "dt-bindings/zmk/ext_power.h"
#include "dt-bindings/zmk/rgb.h"

&spi3 {
  led_strip: ws2812@0 {
    /* WS2812 */
    chain-length = <27>; /* There are per-key RGB, but the first 6 are underglow */
  };
};

#define CONFIG_WIRELESS

#include "zmk-helpers/key-labels/42.h"
#include "base.keymap"
